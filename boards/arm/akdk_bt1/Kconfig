## boards/arm/akdk_bt1/Kconfig
```kconfig
config BOARD_AKDK_BT1
    bool "AKDK BT1"
    default y

config BOARD_ENABLE_DCDC
    bool "Enable DCDC mode"
    default y
    depends on BOARD_AKDK_BT1
```

## boards/arm/akdk_bt1/Kconfig.defconfig
```kconfig
if BOARD_AKDK_BT1

# ▼▼▼ 追加・修正箇所ここから ▼▼▼
config BOARD
    default "akdk_bt1"
# ▲▲▲ 追加・修正箇所ここまで ▲▲▲

if USB_DEVICE_STACK

config USB_NRFX
    default y

endif # USB_DEVICE_STACK

config BT_CTLR
    default BT

endif
```

## boards/arm/akdk_bt1/board.yml
```yaml
board:
  name: akdk_bt1
  full_name: AKDK BT1
  vendor: custom
  socs:
    - name: nrf52840_qiaa
```

## boards/pama_key/Kconfig.defconfig
```kconfig
if SHIELD_PAMA_KEY_RIGHT

config ZMK_KEYBOARD_NAME
    default "PaMa_key"

endif

if SHIELD_PAMA_KEY_LEFT || SHIELD_PAMA_KEY_RIGHT

config ZMK_SPLIT
    default y

endif
```

## boards/pama_key/Kconfig.shield
```kconfig
config SHIELD_YKEY_FOR_FARM_LEFT
    def_bool $(shields_list_contains,ykey_for_farm_left)
config SHIELD_YKEY_FOR_FARM_RIGHT
    def_bool $(shields_list_contains,ykey_for_farm_right)
```

## boards/shields/PaMa_Key/Kconfig.shield
```kconfig
config SHIELD_PAMA_KEY_LEFT
    def_bool $(shields_list_contains,PaMa_Key_left)
config SHIELD_PAMA_KEY_RIGHT
    def_bool $(shields_list_contains,PaMa_Key_right)
```

## boards/shields/ykey_for_farm/Kconfig.defconfig
```kconfig
if SHIELD_YKEY_FOR_FARM_RIGHT

config ZMK_KEYBOARD_NAME
    default "PaMa_key"

endif

if SHIELD_YKEY_FOR_FARM_LEFT || SHIELD_YKEY_FOR_FARM_RIGHT

config ZMK_SPLIT
    default y

endif
```
